## conf/machine/chip.conf
```bitbake
#@TYPE: Machine
#@NAME: C.H.I.P. board
#@DESCRIPTION: Machine configuration for C.H.I.P. board

MACHINE_EXTRA_RRECOMMENDS = " kernel-modules kernel-devicetree"

EXTRA_IMAGEDEPENDS += "u-boot"

DEFAULTTUNE ?= "cortexa8t-neon"
include conf/machine/include/tune-cortexa8.inc

IMAGE_FSTYPES += "ubi tar"

SERIAL_CONSOLE = "115200 ttyS0"

PREFERRED_PROVIDER_virtual/kernel ?= "linux-ingesup"
PREFERRED_PROVIDER_u-boot ?= "u-boot-chip"

KERNEL_IMAGETYPE = "zImage"
KERNEL_DEVICETREE = "sun5i-r8-chip.dtb"

SPL_BINARY = "spl/sunxi-spl.bin"
UBOOT_BINARY = "u-boot-dtb.bin"
UBOOT_MACHINE = "CHIP_defconfig"

MACHINE_FEATURES = "usbgadget usbhost wifi"

# Include wifi modules and firmware
MACHINE_EXTRA_RRECOMMENDS = "kernel-module-r8723bs rtl8723bs"

UBI_VOLNAME = "rootfs"
MKUBIFS_ARGS = "-e 2064384 -c 4096 -m 16384"
UBINIZE_ARGS = "-m 0x4000 -p 0x200000 -s 16384"
```

## conf/machine/chippro.conf
```bitbake
#@TYPE: Machine
#@NAME: C.H.I.P. PRO board
#@DESCRIPTION: Machine configuration for C.H.I.P. PRO board

MACHINE_EXTRA_RRECOMMENDS = " kernel-modules kernel-devicetree"

EXTRA_IMAGEDEPENDS += "u-boot"

DEFAULTTUNE ?= "cortexa8t-neon"
include conf/machine/include/tune-cortexa8.inc

IMAGE_FSTYPES += "tar"

SERIAL_CONSOLE = "115200 ttyS0"

PREFERRED_PROVIDER_virtual/kernel ?= "linux-chip"
PREFERRED_PROVIDER_u-boot ?= "u-boot-chip"

KERNEL_IMAGETYPE = "zImage"
KERNEL_DEVICETREE = "ntc-gr8-crumb.dtb"

SPL_BINARY = "spl/sunxi-spl.bin"
UBOOT_BINARY = "u-boot-dtb.bin"
UBOOT_MACHINE = "CHIP_defconfig"

MACHINE_FEATURES = "usbgadget usbhost wifi"

KERNEL_MODULE_AUTOLOAD += " \
			g_cdc \
			"

# Include wifi modules and firmware
MACHINE_EXTRA_RRECOMMENDS = "kernel-module-r8723ds rtl8723ds rtl8723bs-bt axp209"
```
